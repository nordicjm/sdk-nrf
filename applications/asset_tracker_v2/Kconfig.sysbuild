## applications/asset_tracker_v2/Kconfig.sysbuild
```kconfig
#
# Copyright (c) 2023 Nordic Semiconductor
#
# SPDX-License-Identifier: LicenseRef-Nordic-5-Clause
#

choice BOOTLOADER
	default BOOTLOADER_MCUBOOT if !BOARD_NATIVE_SIM
endchoice

config SECURE_BOOT
	default y if BOARD_NRF9160DK_NRF9160_NS

config SECURE_BOOT_APPCORE
	default y if BOARD_NRF9160DK_NRF9160_NS

config PM_EXTERNAL_FLASH_MCUBOOT_SECONDARY
	default y if BOARD_NRF9151DK_NRF9151_NS || BOARD_NRF9161DK_NRF9161_NS
	default y if BOARD_NRF9160DK_NRF9160_NS && "${BOARD_REVISION}" = "0.14.0"

source "${ZEPHYR_BASE}/share/sysbuild/Kconfig"
```

## applications/connectivity_bridge/Kconfig.sysbuild
```kconfig
#
# Copyright (c) 2024 Nordic Semiconductor
#
# SPDX-License-Identifier: LicenseRef-Nordic-5-Clause
#

config NRF_DEFAULT_BLUETOOTH
	default y if BOARD_THINGY91X_NRF5340_CPUAPP

source "${ZEPHYR_BASE}/share/sysbuild/Kconfig"
```

## applications/connectivity_bridge/sample.yaml
```yaml
sample:
  description: Connectivity Bridge application
  name: Connectivity Bridge
tests:
  applications.connectivity_bridge:
    build_only: true
    platform_allow:
      - thingy91/nrf52840
      - thingy91x/nrf5340/cpuapp
    integration_platforms:
      - thingy91/nrf52840
    tags: ci_build
  applications.connectivity_bridge.sysbuild:
    sysbuild: true
    build_only: true
    platform_allow:
      - thingy91/nrf52840
      - thingy91x/nrf5340/cpuapp
    integration_platforms:
      - thingy91/nrf52840
    tags: ci_build sysbuild
```

## applications/machine_learning/Kconfig.sysbuild
```kconfig
#
# Copyright (c) 2023 Nordic Semiconductor
#
# SPDX-License-Identifier: LicenseRef-Nordic-5-Clause
#

choice BOOTLOADER
        default BOOTLOADER_MCUBOOT if $(BOARD) = "nrf5340dk_nrf5340_cpuapp"
endchoice

config NRF_DEFAULT_BLUETOOTH
        default y if $(BOARD) = "nrf5340dk_nrf5340_cpuapp"

source "${ZEPHYR_BASE}/share/sysbuild/Kconfig"
```

## applications/nrf_desktop/Kconfig.sysbuild
```kconfig
#
# Copyright (c) 2024 Nordic Semiconductor ASA
#
# SPDX-License-Identifier: LicenseRef-Nordic-5-Clause
#

config NRF_DEFAULT_BLUETOOTH
	default y if BOARD_NRF5340DK

choice BOOTLOADER
	default BOOTLOADER_MCUBOOT if BOARD_NRF52833DK_NRF52833 || BOARD_NRF52833DONGLE || BOARD_NRF54L15PDK
endchoice

choice MCUBOOT_MODE
	default MCUBOOT_MODE_SINGLE_APP if BOARD_NRF52833DK || BOARD_NRF52820DONGLE || BOARD_NRF52833DONGLE
endchoice

config SECURE_BOOT
	default y if BOARD_NRF5340DK || BOARD_NRF52840DONGLE || BOARD_NRF52840DK

config SECURE_BOOT_APPCORE
	default y if BOARD_NRF5340DK || BOARD_NRF52840DONGLE || BOARD_NRF52840DK

source "${ZEPHYR_BASE}/share/sysbuild/Kconfig"
```

## applications/nrf_desktop/sample.yaml
```yaml
sample:
  name: nRF52 Desktop
  description: BLE HID device reference design
tests:
  applications.nrf_desktop.sysbuild1:
    sysbuild: true
    build_only: true
    platform_allow: nrf52840dk_nrf52840
    integration_platforms:
      - nrf52840dk_nrf52840
    extra_args: SB_CONFIG_SECURE_BOOT=y b0_CONF_FILE=/tmp/ccd/nrf/applications/nrf_desktop/configuration/nrf52840dk_nrf52840/child_image/b0/prj.conf
  applications.nrf_desktop.sysbuild2:
    sysbuild: true
    build_only: true
    platform_allow: nrf5340dk_nrf5340_cpuapp
    integration_platforms:
      - nrf5340dk_nrf5340_cpuapp
    extra_args: SB_CONFIG_SECURE_BOOT=y b0_CONF_FILE=/tmp/ccd/nrf/applications/nrf_desktop/configuration/nrf5340dk_nrf5340_cpuapp/child_image/b0/prj.conf
  applications.nrf_desktop.sysbuild3:
    sysbuild: true
    build_only: true
    platform_allow: nrf52kbd_nrf52832
    integration_platforms:
      - nrf52kbd_nrf52832
    extra_args: SB_CONFIG_SECURE_BOOT=y b0_CONF_FILE=/tmp/ccd/nrf/applications/nrf_desktop/configuration/nrf52kbd_nrf52832/child_image/b0/prj.conf
  applications.nrf_desktop.sysbuild4:
    sysbuild: true
    build_only: true
    platform_allow: nrf52840gmouse_nrf52840
    integration_platforms:
      - nrf52840gmouse_nrf52840
    extra_args: SB_CONFIG_SECURE_BOOT=y b0_CONF_FILE=/tmp/ccd/nrf/applications/nrf_desktop/configuration/nrf52840gmouse_nrf52840/child_image/b0/prj.conf
  applications.nrf_desktop.sysbuild5:
    sysbuild: true
    build_only: true
    platform_allow: nrf52840dongle_nrf52840
    integration_platforms:
      - nrf52840dongle_nrf52840
    extra_args: SB_CONFIG_SECURE_BOOT=y b0_CONF_FILE=/tmp/ccd/nrf/applications/nrf_desktop/configuration/nrf52840dongle_nrf52840/child_image/b0/prj.conf
```

## samples/bluetooth/direction_finding_connectionless_rx/Kconfig.sysbuild
```kconfig
rsource "${ZEPHYR_BASE}/share/sysbuild/Kconfig"

config NRF_DEFAULT_BLUETOOTH
	bool
	default y
```

## samples/cellular/nidd/sample.yaml
```yaml
sample:
  name: NIDD sample
tests:
  samples.cellular.nidd:
    build_only: true
    platform_allow:
      - nrf9151dk_nrf9151_ns
      - nrf9160dk_nrf9160_ns
      - nrf9161dk_nrf9161_ns
      - thingy91/nrf9160/ns
      - thingy91x/nrf9151/ns
    integration_platforms:
      - nrf9151dk_nrf9151_ns
      - nrf9160dk_nrf9160_ns
      - nrf9161dk_nrf9161_ns
      - thingy91/nrf9160/ns
    tags: ci_build
```

## samples/net/aws_iot/sample.yaml
```yaml
sample:
  name: AWS IoT sample
tests:
  sample.net.aws_iot:
    tags: ci_build
    build_only: true
    build_on_all: true
    integration_platforms:
      - nrf9160dk/nrf9160/ns
      - nrf9161dk/nrf9161/ns
      - nrf9151dk/nrf9151/ns
      - thingy91/nrf9160/ns
      - nrf7002dk/nrf5340/cpuapp/ns
    platform_allow:
      - nrf9160dk/nrf9160/ns
      - nrf9161dk/nrf9161/ns
      - nrf9151dk/nrf9151/ns
      - thingy91/nrf9160/ns
      - thingy91x/nrf9151/ns
      - nrf7002dk/nrf5340/cpuapp/ns
  sample.net.aws_iot.sysbuild:
    sysbuild: true
    tags: ci_build sysbuild
    build_only: true
    build_on_all: true
    integration_platforms:
      - nrf9160dk/nrf9160/ns
      - nrf9161dk/nrf9161/ns
      - nrf9151dk/nrf9151/ns
      - thingy91/nrf9160/ns
      # NCSDK-24849 - wifi configuration needs sorting out
      # - nrf7002dk/nrf5340/cpuapp
    platform_allow:
      - nrf9160dk/nrf9160/ns
      - nrf9161dk/nrf9161/ns
      - nrf9151dk/nrf9151/ns
      - thingy91/nrf9160/ns
      - thingy91x/nrf9151/ns
      # - nrf7002dk_nrf5340_cpuapp_ns
```

## samples/net/download/sample.yaml
```yaml
sample:
  name: Download sample
tests:
  sample.net.download_client:
    build_only: true
    integration_platforms:
      - nrf9161dk/nrf9161/ns
    platform_allow:
      - nrf9161dk/nrf9161/ns
    tags: ci_build
  sample.net.download_client.sysbuild:
    sysbuild: true
    build_only: true
    integration_platforms:
      - nrf9161dk/nrf9161/ns
    platform_allow:
      - nrf9161dk/nrf9161/ns
    tags: ci_build sysbuild
  sample.net.download_client.ci:
    build_only: true
    extra_configs:
      - CONFIG_SHELL=y
      - CONFIG_COAP=y
      - CONFIG_DOWNLOAD_CLIENT_SHELL=y
      - CONFIG_SAMPLE_COMPUTE_HASH=y
    integration_platforms:
      - nrf9160dk/nrf9160/ns
      - nrf9161dk/nrf9161/ns
      - nrf9151dk/nrf9151/ns
      - nrf7002dk/nrf5340/cpuapp/ns
    platform_allow:
      - nrf9160dk/nrf9160/ns
      - nrf9161dk/nrf9161/ns
      - nrf9151dk/nrf9151/ns
      - nrf7002dk/nrf5340/cpuapp/ns
    tags: ci_build
  sample.net.download_client.ci.sysbuild:
    sysbuild: true
    build_only: true
    extra_configs:
      - CONFIG_SHELL=y
      - CONFIG_COAP=y
      - CONFIG_DOWNLOAD_CLIENT_SHELL=y
      - CONFIG_SAMPLE_COMPUTE_HASH=y
    integration_platforms:
      - nrf9160dk/nrf9160/ns
      - nrf9161dk/nrf9161/ns
      - nrf9151dk/nrf9151/ns
      # NCSDK-24849 - wifi configuration needs sorting out
      # - nrf7002dk/nrf5340/cpuapp
    platform_allow:
      - nrf9160dk/nrf9160/ns
      - nrf9161dk/nrf9161/ns
      - nrf9151dk/nrf9151/ns
      # - nrf7002dk/nrf5340/cpuapp
    tags: ci_build sysbuild
```

## samples/net/udp/sample.yaml
```yaml
sample:
  name: UDP sample
tests:
  sample.net.udp:
    sysbuild: true
    build_only: true
    integration_platforms:
      - nrf9160dk/nrf9160/ns
      - nrf9161dk/nrf9161/ns
      - nrf9151dk/nrf9151/ns
      - thingy91/nrf9160/ns
      - nrf7002dk/nrf5340/cpuapp/ns
    platform_allow:
      - nrf9160dk/nrf9160/ns
      - nrf9161dk/nrf9161/ns
      - nrf9151dk/nrf9151/ns
      - thingy91/nrf9160/ns
      - nrf7002dk/nrf5340/cpuapp/ns
    tags: ci_build sysbuild
  sample.net.udp.emulation:
    sysbuild: true
    build_only: true
    integration_platforms:
      - qemu_x86
    platform_allow:
      - qemu_x86
    tags: ci_build sysbuild
```

## samples/nrf5340/multiprotocol_rpmsg/Kconfig
```kconfig
#
# Copyright (c) 2022 Nordic Semiconductor
#
# SPDX-License-Identifier: LicenseRef-Nordic-5-Clause
#

source "Kconfig.zephyr"

menu "Nordic Multiprotocol RPMsg sample"

config MULTIPROTOCOL_RPMSG_LOG_LEVEL
	int "Default log level"
	range 0 4
	default 0

endmenu
```

## samples/tfm/tfm_hello_world/sample.yaml
```yaml
sample:
  description: Hello World sample, the simplest Zephyr
    application, with TF-M enabled
  name: hello world TFM
common:
  tags: tfm
  platform_allow: nrf5340dk/nrf5340/cpuapp/ns nrf9160dk/nrf9160/ns nrf54l15pdk/nrf54l15/cpuapp/ns
  integration_platforms:
    - nrf5340dk/nrf5340/cpuapp/ns
    - nrf9160dk/nrf9160/ns
  harness: console
  harness_config:
    type: multi_line
    regex:
      - ".*Example finished successfully!.*"
tests:
  sample.tfm.helloworld:
    tags: ci_build
  sample.tfm.helloworld.sysbuild:
    sysbuild: true
    tags: ci_build sysbuild
  sample.tfm.hello_world.bootloaders:
    tags: ci_build
    extra_args: CONFIG_BOOTLOADER_MCUBOOT=y CONFIG_SECURE_BOOT=y
      CONFIG_MCUBOOT_HARDWARE_DOWNGRADE_PREVENTION=y
    platform_exclude: nrf54l15pdk/nrf54l15/cpuapp/ns
  sample.tfm.hello_world.bootloaders.sysbuild:
    sysbuild: true
    tags: ci_build sysbuild
    extra_args: CONFIG_BOOTLOADER_MCUBOOT=y CONFIG_SECURE_BOOT=y
      CONFIG_MCUBOOT_HARDWARE_DOWNGRADE_PREVENTION=y
    platform_exclude: nrf54l15pdk/nrf54l15/cpuapp/ns
  sample.tfm.hello_world.bootloaders_debug:
    build_only: true
    tags: ci_build
    extra_args: CONFIG_BOOTLOADER_MCUBOOT=y CONFIG_SECURE_BOOT=y CONFIG_DEBUG_OPTIMIZATIONS=y
    platform_exclude: nrf54l15pdk/nrf54l15/cpuapp/ns
  sample.tfm.hello_world.bootloaders_debug.sysbuild:
    sysbuild: true
    build_only: true
    tags: ci_build sysbuild
    extra_args: CONFIG_BOOTLOADER_MCUBOOT=y CONFIG_SECURE_BOOT=y CONFIG_DEBUG_OPTIMIZATIONS=y
    platform_exclude: nrf54l15pdk/nrf54l15/cpuapp/ns
  sample.tfm.hello_world.full:
    tags: ci_build
    extra_args: CONFIG_TFM_PROFILE_TYPE_NOT_SET=y CONFIG_NRF_SECURITY=y
    platform_exclude: nrf54l15pdk/nrf54l15/cpuapp/ns
  sample.tfm.hello_world.full.sysbuild:
    sysbuild: true
    tags: ci_build sysbuild
    extra_args: CONFIG_TFM_PROFILE_TYPE_NOT_SET=y CONFIG_NRF_SECURITY=y
    platform_exclude: nrf54l15pdk/nrf54l15/cpuapp/ns
  sample.tfm.hello_world.lvl2:
    tags: ci_build
    extra_args: CONFIG_TFM_IPC=y CONFIG_TFM_ISOLATION_LEVEL=2 CONFIG_TFM_PROFILE_TYPE_NOT_SET=y
    platform_exclude: nrf54l15pdk/nrf54l15/cpuapp/ns
  sample.tfm.hello_world.lvl2.sysbuild:
    sysbuild: true
    tags: ci_build sysbuild
    extra_args: CONFIG_TFM_IPC=y CONFIG_TFM_ISOLATION_LEVEL=2 CONFIG_TFM_PROFILE_TYPE_NOT_SET=y
    platform_exclude: nrf54l15pdk/nrf54l15/cpuapp/ns
```

## samples/zigbee/light_switch/Kconfig.sysbuild
```kconfig
#
# Copyright (c) 2023 Nordic Semiconductor
#
# SPDX-License-Identifier: LicenseRef-Nordic-5-Clause
#

config NRF_DEFAULT_IPC_RADIO
	default y

config NETCORE_IPC_RADIO_BT_HCI_IPC
	default y

config NETCORE_IPC_RADIO_IEEE802154
	default y

config PM_EXTERNAL_FLASH_MCUBOOT_SECONDARY
	default y if BOARD_NRF5340DK_NRF5340_CPUAPP

source "${ZEPHYR_BASE}/share/sysbuild/Kconfig"
```
