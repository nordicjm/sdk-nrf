## samples/zigbee/light_switch/sample.yaml
```yaml
sample:
  description: Zigbee dimmable light switch based on ZBOSS stack
  name: Zigbee Light switch
tests:
  sample.zigbee.light_switch:
    build_only: true
    integration_platforms:
      - nrf52840dk/nrf52840
      - nrf52833dk/nrf52833
      - nrf5340dk/nrf5340/cpuapp
      - nrf21540dk/nrf52840
    platform_allow: nrf52840dk/nrf52840 nrf52833dk/nrf52833 nrf5340dk/nrf5340/cpuapp
      nrf21540dk/nrf52840
    tags: ci_build smoke
  sample.zigbee.light_switch.sysbuild:
    sysbuild: true
    build_only: true
    integration_platforms:
      - nrf52840dk/nrf52840
      - nrf52833dk/nrf52833
      - nrf5340dk/nrf5340/cpuapp
      - nrf21540dk/nrf52840
    platform_allow: nrf52840dk/nrf52840 nrf52833dk/nrf52833 nrf5340dk/nrf5340/cpuapp
      nrf21540dk/nrf52840
    tags: ci_build smoke sysbuild
  sample.zigbee.light_switch.current_measurement:
    build_only: true
    extra_args: CONFIG_SERIAL=n
    integration_platforms:
      - nrf52840dk/nrf52840
      - nrf52833dk/nrf52833
      - nrf5340dk/nrf5340/cpuapp
    platform_allow: nrf52840dk/nrf52840 nrf52833dk/nrf52833 nrf5340dk/nrf5340/cpuapp
    tags: ci_build current_measurement
  sample.zigbee.light_switch.current_measurement.sysbuild:
    sysbuild: true
    build_only: true
    extra_args: CONFIG_SERIAL=n
    integration_platforms:
      - nrf52840dk/nrf52840
      - nrf52833dk/nrf52833
      - nrf5340dk/nrf5340/cpuapp
    platform_allow: nrf52840dk/nrf52840 nrf52833dk/nrf52833 nrf5340dk/nrf5340/cpuapp
    tags: ci_build current_measurement sysbuild
  sample.zigbee.light_switch.fota:
    build_only: true
    extra_args: CONF_FILE=prj_fota.conf
    integration_platforms:
      - nrf52840dk/nrf52840
      - nrf21540dk/nrf52840
      - nrf5340dk/nrf5340/cpuapp
    platform_allow: nrf52840dk/nrf52840 nrf21540dk/nrf52840 nrf5340dk/nrf5340/cpuapp
    tags: ci_build smoke
  sample.zigbee.light_switch.fota.sysbuild1:
    sysbuild: true
    build_only: true
    extra_args: >
      FILE_SUFFIX=fota SB_CONFIG_DFU_MULTI_IMAGE_PACKAGE_BUILD=y
      SB_CONFIG_BOOTLOADER_MCUBOOT=y SB_CONFIG_DFU_MULTI_IMAGE_PACKAGE_APP=y
    integration_platforms:
      - nrf52840dk/nrf52840
      - nrf21540dk/nrf52840
    platform_allow: nrf52840dk/nrf52840 nrf21540dk/nrf52840
    tags: ci_build smoke sysbuild
  sample.zigbee.light_switch.fota.sysbuild2:
    sysbuild: true
    build_only: true
    extra_args: >
      FILE_SUFFIX=fota SB_CONFIG_DFU_MULTI_IMAGE_PACKAGE_BUILD=y
      SB_CONFIG_BOOTLOADER_MCUBOOT=y SB_CONFIG_SECURE_BOOT=y SB_CONFIG_SECURE_BOOT_NETCORE=y
      SB_CONFIG_DFU_MULTI_IMAGE_PACKAGE_APP=y SB_CONFIG_DFU_MULTI_IMAGE_PACKAGE_NET=y
    integration_platforms:
      - nrf5340dk/nrf5340/cpuapp
    platform_allow: nrf5340dk/nrf5340/cpuapp
    tags: ci_build smoke sysbuild
  sample.zigbee.light_switch.fota_and_multiprotocol:
    build_only: true
    extra_args: CONF_FILE=prj_fota.conf OVERLAY_CONFIG=overlay-multiprotocol_ble.conf
    integration_platforms:
      - nrf52840dk/nrf52840
      - nrf5340dk/nrf5340/cpuapp
    platform_allow: nrf52840dk/nrf52840 nrf5340dk/nrf5340/cpuapp
    tags: ci_build
  sample.zigbee.light_switch.fota_and_multiprotocol.sysbuild1:
    sysbuild: true
    build_only: true
    extra_args: >
      FILE_SUFFIX=fota OVERLAY_CONFIG=overlay-multiprotocol_ble.conf
      SB_CONFIG_DFU_MULTI_IMAGE_PACKAGE_BUILD=y SB_CONFIG_BOOTLOADER_MCUBOOT=y
      SB_CONFIG_DFU_MULTI_IMAGE_PACKAGE_APP=y
    integration_platforms:
      - nrf52840dk/nrf52840
    platform_allow: nrf52840dk/nrf52840
    tags: ci_build sysbuild
  sample.zigbee.light_switch.fota_and_multiprotocol.sysbuild2:
    sysbuild: true
    build_only: true
    extra_args: >
      FILE_SUFFIX=fota OVERLAY_CONFIG=overlay-multiprotocol_ble.conf
      SB_CONFIG_DFU_MULTI_IMAGE_PACKAGE_BUILD=y SB_CONFIG_BOOTLOADER_MCUBOOT=y
      SB_CONFIG_SECURE_BOOT=y SB_CONFIG_SECURE_BOOT_NETCORE=y
      SB_CONFIG_DFU_MULTI_IMAGE_PACKAGE_APP=y SB_CONFIG_DFU_MULTI_IMAGE_PACKAGE_NET=y
    integration_platforms:
      - nrf5340dk/nrf5340/cpuapp
    platform_allow: nrf5340dk/nrf5340/cpuapp
    tags: ci_build sysbuild
  sample.zigbee.light_switch.multiprotocol:
    build_only: true
    extra_args: OVERLAY_CONFIG=overlay-multiprotocol_ble.conf
    integration_platforms:
      - nrf52840dk/nrf52840
      - nrf52833dk/nrf52833
      - nrf5340dk/nrf5340/cpuapp
    platform_allow: nrf52840dk/nrf52840 nrf52833dk/nrf52833 nrf5340dk/nrf5340/cpuapp
    tags: ci_build
  sample.zigbee.light_switch.multiprotocol.sysbuild:
    sysbuild: true
    build_only: true
    extra_args: OVERLAY_CONFIG=overlay-multiprotocol_ble.conf
    integration_platforms:
      - nrf52840dk/nrf52840
      - nrf52833dk/nrf52833
      - nrf5340dk/nrf5340/cpuapp
    platform_allow: nrf52840dk/nrf52840 nrf52833dk/nrf52833 nrf5340dk/nrf5340/cpuapp
    tags: ci_build sysbuild
  sample.zigbee.light_switch.with_shell:
    build_only: true
    extra_args: >
      CONFIG_ZIGBEE_SHELL=y CONFIG_ZIGBEE_SHELL_DEBUG_CMD=y CONFIG_ZIGBEE_LOGGER_EP=n
      CONFIG_ZIGBEE_SHELL_ENDPOINT=1 CONFIG_LOG_MODE_DEFERRED=y
    integration_platforms:
      - nrf52840dk/nrf52840
      - nrf52833dk/nrf52833
      - nrf5340dk/nrf5340/cpuapp
      - nrf21540dk/nrf52840
    platform_allow: nrf52840dk/nrf52840 nrf52833dk/nrf52833 nrf5340dk/nrf5340/cpuapp
      nrf21540dk/nrf52840
    tags: ci_build shell
  sample.zigbee.light_switch.with_shell.sysbuild:
    sysbuild: true
    build_only: true
    extra_args: >
      CONFIG_ZIGBEE_SHELL=y CONFIG_ZIGBEE_SHELL_DEBUG_CMD=y CONFIG_ZIGBEE_LOGGER_EP=n
      CONFIG_ZIGBEE_SHELL_ENDPOINT=1 CONFIG_LOG_MODE_DEFERRED=y
    integration_platforms:
      - nrf52840dk/nrf52840
      - nrf52833dk/nrf52833
      - nrf5340dk/nrf5340/cpuapp
      - nrf21540dk/nrf52840
    platform_allow: nrf52840dk/nrf52840 nrf52833dk/nrf52833 nrf5340dk/nrf5340/cpuapp
      nrf21540dk/nrf52840
    tags: ci_build shell sysbuild
```

## samples/zigbee/template/Kconfig.sysbuild
```kconfig
rsource "${ZEPHYR_BASE}/share/sysbuild/Kconfig"

config NRF_DEFAULT_802154
	bool
	default y
```

## sysbuild/Kconfig.bootloader
```kconfig
#
# Copyright (c) 2022 Nordic Semiconductor
#
# SPDX-License-Identifier: LicenseRef-Nordic-5-Clause
#

config SECURE_BOOT
	bool "Secure Bootloader"
	default y if $(BOARD) = "nrf5340dk_nrf5340_cpuapp"
	depends on BOOTLOADER_MCUBOOT
	help
	  Set this option to enable the first stage bootloader which
	  verifies the signature of the app.
```

## sysbuild/Kconfig.fast_pair
```kconfig
# Copyright (c) 2023 Nordic Semiconductor
#
# SPDX-License-Identifier: LicenseRef-Nordic-5-Clause

config FAST_PAIR_SUPPORT
	bool "Bluetooth fast pair suport"
	help
	  Enable this option to generate a fast pair provision hex file and enable support for
	  Bluetooth fair pairing support in the main image. Note that `FP_MODEL_ID` and
	  `FP_ANTI_SPOOFING_KEY` variables must be supplied when configuring the application
	  for this functionality to be available.
```

## sysbuild/Kconfig.image.template
```kconfig
# This is a Kconfig @template@ file used for passing sysbuild controlled Kconfig
# settings from sysbuild to images.

config PARTITION_MANAGER_ENABLED
	bool
	default y if "@SB_CONFIG_PARTITION_MANAGER@"
```

## sysbuild/Kconfig.mcuboot
```kconfig
# Copyright (c) 2023 Nordic Semiconductor
#
# SPDX-License-Identifier: LicenseRef-Nordic-5-Clause

menu "MCUboot configuration"
	depends on BOOTLOADER_MCUBOOT

menuconfig MCUBOOT_HARDWARE_DOWNGRADE_PREVENTION
	bool "Downgrade prevention using hardware security counters"
	depends on ($(BOARD) = "nrf5340dk_nrf5340_cpuapp" || $(BOARD) = "nrf5340dk_nrf5340_cpuapp_ns" || $(BOARD) = "thingy53_nrf5340_cpuapp" || $(BOARD) = "thingy53_nrf5340_cpuapp_ns" || $(BOARD) = "nrf9160dk_nrf9160" || $(BOARD) = "nrf9160dk_nrf9160_ns" || $(BOARD) = "thingy91_nrf9160" || $(BOARD) = "thingy91_nrf9160_ns")
	help
	  This option can be enabled by the application and will ensure
	  that the MCUBOOT_HW_DOWNGRADE_PREVENTION Kconfig option is
	  enabled in the MCUboot image.

if MCUBOOT_HARDWARE_DOWNGRADE_PREVENTION

config MCUBOOT_HW_DOWNGRADE_PREVENTION_COUNTER_SLOTS
	int "Number of available hardware counter slots"
	default 240
	range 2 300
	help
	  When MCUBOOT_HW_DOWNGRADE_PREVENTION is enabled, MCUboot will use
	  one hardware counter for each updatable image (UPDATEABLE_IMAGE_NUMBER).
	  This configuration specifies how many counter slots will be allocated
	  for each hardware counter. The hardware counters are stored in OTP storage.
	  The rationale for the default number (240): Assume one update a month for
	  10 years, then double that value just in case. This default fits
	  comfortably within the OTP region of UICR.

config MCUBOOT_HW_DOWNGRADE_PREVENTION_COUNTER_VALUE
	int "Security counter value"
	default 1
	range 1 65535
	help
	  The security counter value for this image.
	  This is the value that will be passed to the --security-counter
	  parameter of imgtool.py

endif # MCUBOOT_HARDWARE_DOWNGRADE_PREVENTION

config MCUBOOT_MAX_UPDATEABLE_IMAGES
	int
	default 3

config MCUBOOT_UPDATEABLE_IMAGES
	int "Updateable images"
	range 3 MCUBOOT_MAX_UPDATEABLE_IMAGES if QSPI_XIP_SUPPORT
	range 2 MCUBOOT_MAX_UPDATEABLE_IMAGES if NETCORE_APP_UPDATE
	range 1 MCUBOOT_MAX_UPDATEABLE_IMAGES
	help
	  The number of images that MCUboot will be built with.

config SECURE_BOOT_MCUBOOT_VERSION
	string "MCUboot S0/S1 image update version"
	default "0.0.0+0"
	depends on SECURE_BOOT
	help
	  The version of the MCUboot S0/S1 upgrade package

endmenu
```

## sysbuild/Kconfig.nrf
```kconfig
#
# Copyright (c) 2022 Nordic Semiconductor
#
# SPDX-License-Identifier: LicenseRef-Nordic-5-Clause
#

config SOME_FAKE_CONFIG_VALUE
	int "test int value for sysbuild"
	help
	  Value should only be part of sysbuild
```

## sysbuild/Kconfig.radio
```kconfig
# Copyright (c) 2022 Nordic Semiconductor
#
# SPDX-License-Identifier: Apache-2.0

config SUPPORT_RADIO
	bool
	default y

config SUPPORT_RADIO_HCI_RPMSG
	bool
	default y

choice RADIO
	prompt "Radio support"
	default RADIO_NONE
	depends on SUPPORT_RADIO

config RADIO_NONE
	bool "None"
	help
	  Do not Include a radio image in the build

config RADIO_HCI_RPMSG
	bool "hci_rpmsg"
	depends on SUPPORT_RADIO_HCI_RPMSG
	help
	  Include hci_rpmsg as the radio image to use

endchoice

config RADIO_HCI_RPMSG_NAME
	string
	default "hci_rpmsg"
	depends on RADIO_HCI_RPMSG
	help
	  Image name of radio hci rpmsg.

config RADIO_HCI_RPMSG_BOARD
	string
	default "nrf5340dk_nrf5340_cpunet" if $(BOARD) = "nrf5340dk_nrf5340_cpuapp"
	depends on RADIO_HCI_RPMSG
	help
	  Remote board when building this sample.
	  If not set, the board given to sysbuild is used.

config RADIO_HCI_RPMSG_DOMAIN
	string
	default "CPUNET" if RADIO_HCI_RPMSG_BOARD = "nrf5340dk_nrf5340_cpunet"

config RADIO_HCI_RPMSG_DOMAIN_APP
	bool
	default y if RADIO_HCI_RPMSG_BOARD = "nrf5340dk_nrf5340_cpunet"

config SUPPORT_RADIO_BOOTLOADER
	bool
	default y

config SUPPORT_RADIO_BOOTLOADER_B0N
	bool
	default y

choice RADIO_BOOTLOADER
	prompt "Radio-core bootloader support"
	default RADIO_BOOTLOADER_NONE
	depends on SUPPORT_RADIO_BOOTLOADER

config RADIO_BOOTLOADER_NONE
	bool "None"
	help
	  Do not Include a radio bootloader image in the build

config RADIO_BOOTLOADER_B0N
	bool "b0n"
	depends on SUPPORT_RADIO_BOOTLOADER_B0N
	help
	  Include b0n as the radio bootloader image to use

endchoice

config RADIO_BOOTLOADER_B0N_NAME
	string
	default "b0n"
	depends on RADIO_BOOTLOADER_B0N
	help
	  Image name of radio hci rpmsg.

config RADIO_BOOTLOADER_B0N_BOARD
	string
	default "nrf5340dk_nrf5340_cpunet" if $(BOARD) = "nrf5340dk_nrf5340_cpuapp"
	depends on RADIO_BOOTLOADER_B0N
	help
	  Remote board when building this sample.
	  If not set, the board given to sysbuild is used.

config RADIO_BOOTLOADER_B0N_DOMAIN
	string
	default "CPUNET" if RADIO_HCI_RPMSG_BOARD = "nrf5340dk_nrf5340_cpunet"
```
