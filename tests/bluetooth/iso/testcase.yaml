## tests/bluetooth/iso/testcase.yaml
```yaml
tests:
  bluetooth.bis_and_acl:
    build_only: true
    platform_allow: nrf5340dk/nrf5340/cpuapp nrf5340_audio_dk/nrf5340/cpuapp
    integration_platforms:
      - nrf5340dk/nrf5340/cpuapp
      - nrf5340_audio_dk/nrf5340/cpuapp
    tags: bis_and_acl
    timeout: 20
  bluetooth.bis_and_acl.sysbuild:
    sysbuild: true
    build_only: true
    platform_allow: nrf5340dk/nrf5340/cpuapp nrf5340_audio_dk/nrf5340/cpuapp
    integration_platforms:
      - nrf5340dk/nrf5340/cpuapp
      - nrf5340_audio_dk/nrf5340/cpuapp
    tags: bis_and_acl sysbuild
    timeout: 20
```

## tests/drivers/fprotect/negative/testcase.yaml
```yaml
tests:
  drivers.fprotect.negative:
    platform_allow: nrf9160dk/nrf9160 nrf52dk/nrf52832
      nrf5340dk/nrf5340/cpuapp nrf52840dk/nrf52840
    integration_platforms:
      - nrf9160dk/nrf9160
      - nrf52dk/nrf52832
      - nrf5340dk/nrf5340/cpuapp
      - nrf52840dk/nrf52840
    tags: b0 fprotect ignore_faults
  drivers.fprotect.negative.sysbuild:
    sysbuild: true
    platform_allow: nrf9160dk/nrf9160 nrf52dk/nrf52832
      nrf5340dk/nrf5340/cpuapp nrf52840dk/nrf52840
    integration_platforms:
      - nrf9160dk/nrf9160
      - nrf52dk/nrf52832
      - nrf5340dk/nrf5340/cpuapp
      - nrf52840dk/nrf52840
    tags: b0 fprotect ignore_faults sysbuild
```

## tests/lib/hw_unique_key_tfm/testcase.yaml
```yaml
tests:
  lib.hw_unique_key_tfm:
    platform_allow: nrf9160dk/nrf9160/ns nrf5340dk/nrf5340/cpuapp/ns
    integration_platforms:
      - nrf9160dk/nrf9160/ns
      - nrf5340dk/nrf5340/cpuapp/ns
    tags: huk
    build_only: true
  lib.hw_unique_key_tfm.sysbuild:
    sysbuild: true
    platform_allow: nrf9160dk/nrf9160/ns nrf5340dk/nrf5340/cpuapp/ns
    integration_platforms:
      - nrf9160dk/nrf9160/ns
      - nrf5340dk/nrf5340/cpuapp/ns
    tags: huk sysbuild
    build_only: true
```

## tests/modules/mcuboot/external_flash/Kconfig.sysbuild
```kconfig
#
# Copyright (c) 2024 Nordic Semiconductor
#
# SPDX-License-Identifier: LicenseRef-Nordic-5-Clause
#

config PM_EXTERNAL_FLASH_MCUBOOT_SECONDARY
	default y if BOARD_NRF5340DK_NRF5340_CPUAPP || BOARD_NRF52840DK_NRF52840

config NRF_DEFAULT_EMPTY
	default y if SOC_SERIES_NRF53X

config SECURE_BOOT
	default y if SOC_SERIES_NRF53X

config SECURE_BOOT_NETCORE
	default y if SECURE_BOOT

config NETCORE_APP_UPDATE
	default y if SOC_SERIES_NRF53X

source "${ZEPHYR_BASE}/share/sysbuild/Kconfig"
```

## tests/subsys/bluetooth/mesh/metadata_extraction/testcase.yaml
```yaml
common:
  build_only: true
  platform_allow: nrf52840dk/nrf52840
  tags: bluetooth ci_build
  integration_platforms:
    - nrf52840dk/nrf52840
tests:
  bluetooth.mesh.metadata_extraction_single:
    extra_configs:
      - CONFIG_COMP_DATA_LAYOUT_SINGLE=y
  bluetooth.mesh.metadata_extraction_single.sysbuild:
    sysbuild: true
    tags: sysbuild
    extra_args:
      - SB_CONFIG_COMP_DATA_LAYOUT_SINGLE=y
  bluetooth.mesh.metadata_extraction_multiple:
    extra_configs:
      - CONFIG_COMP_DATA_LAYOUT_MULTIPLE=y
  bluetooth.mesh.metadata_extraction_multiple.sysbuild:
    sysbuild: true
    tags: sysbuild
    extra_args:
      - SB_CONFIG_COMP_DATA_LAYOUT_MULTIPLE=y
  bluetooth.mesh.metadata_extraction_array:
    extra_configs:
      - CONFIG_COMP_DATA_LAYOUT_ARRAY=y
  bluetooth.mesh.metadata_extraction_array.sysbuild:
    sysbuild: true
    tags: sysbuild
    extra_args:
      - SB_CONFIG_COMP_DATA_LAYOUT_ARRAY=y
  bluetooth.mesh.metadata_extraction_single_lto:
    extra_configs:
      - CONFIG_COMP_DATA_LAYOUT_SINGLE=y
      - CONFIG_ISR_TABLES_LOCAL_DECLARATION=y
      - CONFIG_LTO=y
  bluetooth.mesh.metadata_extraction_single_lto.sysbuild:
    sysbuild: true
    tags: sysbuild
    extra_args:
      - SB_CONFIG_COMP_DATA_LAYOUT_SINGLE=y
    extra_configs:
      - CONFIG_ISR_TABLES_LOCAL_DECLARATION=y
      - CONFIG_LTO=y
```

## tests/subsys/dfu/dfu_target_stream/Kconfig.sysbuild
```kconfig
#
# Copyright (c) 2023 Nordic Semiconductor ASA
#
# SPDX-License-Identifier: LicenseRef-Nordic-5-Clause
#

choice BOOTLOADER
	default BOOTLOADER_MCUBOOT if !BOARD_NATIVE_POSIX
endchoice

#if "$(BOARD)" = "nrf21540dk_nrf52840"

#config BOOTLOADER_MCUBOOT
#	default n

#config BOOTLOADER_NONE
#	default y

#endif

source "${ZEPHYR_BASE}/share/sysbuild/Kconfig"
```

## tests/subsys/net/lib/fota_download/testcase.yaml
```yaml
tests:
  net.lib.fota_download:
    tags: aws fota
    platform_allow: nrf9160dk/nrf9160 nrf9160dk/nrf9160/ns
    integration_platforms:
      - nrf9160dk/nrf9160
      - nrf9160dk/nrf9160/ns
  net.lib.fota_download.sysbuild:
    sysbuild: true
    tags: aws fota sysbuild
    platform_allow: nrf9160dk/nrf9160 nrf9160dk/nrf9160/ns
    integration_platforms:
      - nrf9160dk/nrf9160
      - nrf9160dk/nrf9160/ns
```

## tests/subsys/pcd/testcase.yaml
```yaml
tests:
  dfu.pcd:
    platform_allow: nrf5340dk/nrf5340/cpuapp
    integration_platforms:
      - nrf5340dk/nrf5340/cpuapp
    tags: pcd
  dfu.pcd.sysbuild:
    sysbuild: true
    platform_allow: nrf5340dk/nrf5340/cpuapp
    integration_platforms:
      - nrf5340dk/nrf5340/cpuapp
    tags: pcd sysbuild
```

## tests/subsys/sdfw_services/client_notif/testcase.yaml
```yaml
tests:
  ssf.client_notif:
    platform_allow: native_posix
    integration_platforms:
      - native_posix
    tags: ssf
  ssf.client_notif.sysbuild:
    sysbuild: true
    platform_allow: native_posix
    integration_platforms:
      - native_posix
    tags: ssf sysbuild
```

## tests/subsys/zigbee/osif/crypto/testcase.yaml
```yaml
tests:
  zigbee.osif.crypto:
    platform_allow: nrf52840dk/nrf52840 nrf52833dk/nrf52833 nrf5340dk/nrf5340/cpuapp
    tags: osif_crypto
    integration_platforms:
      - nrf52840dk/nrf52840
      - nrf52833dk/nrf52833
      - nrf5340dk/nrf5340/cpuapp
  zigbee.osif.crypto.sysbuild:
    sysbuild: true
    platform_allow: nrf52840dk/nrf52840 nrf52833dk/nrf52833 nrf5340dk/nrf5340/cpuapp
    tags: osif_crypto sysbuild
    integration_platforms:
      - nrf52840dk/nrf52840
      - nrf52833dk/nrf52833
      - nrf5340dk/nrf5340/cpuapp
```

## tests/subsys/zigbee/osif/serial/serial_via_logger/testcase.yaml
```yaml
tests:
  zigbee.osif.serial.logger:
    platform_allow: nrf52840dk/nrf52840 nrf52833dk/nrf52833 nrf5340dk/nrf5340/cpuapp
    tags: osif_logger
    integration_platforms:
      - nrf52840dk/nrf52840
      - nrf52833dk/nrf52833
      - nrf5340dk/nrf5340/cpuapp
  zigbee.osif.serial.logger.sysbuild:
    sysbuild: true
    platform_allow: nrf52840dk/nrf52840 nrf52833dk/nrf52833 nrf5340dk/nrf5340/cpuapp
    tags: osif_logger sysbuild
    integration_platforms:
      - nrf52840dk/nrf52840
      - nrf52833dk/nrf52833
      - nrf5340dk/nrf5340/cpuapp
```

## tests/tfm/secure_services/testcase.yaml
```yaml
tests:
  tfm.secure_services:
    platform_allow: nrf9160dk/nrf9160/ns nrf5340dk/nrf5340/cpuapp/ns
    tags: tfm secure_services
    integration_platforms:
      - nrf9160dk/nrf9160/ns
      - nrf5340dk/nrf5340/cpuapp/ns
  tfm.secure_services.sysbuild:
    sysbuild: true
    platform_allow: nrf9160dk/nrf9160/ns nrf5340dk/nrf5340/cpuapp/ns
    tags: tfm secure_services sysbuild
    integration_platforms:
      - nrf9160dk/nrf9160/ns
      - nrf5340dk/nrf5340/cpuapp/ns
```

## west.yml
```yaml
# The west manifest file (west.yml) for the nRF Connect SDK (NCS).
#
# The per-workspace west configuration file, ncs/.west/config,
# specifies the location of this manifest file like this:
#
#     [manifest]
#     path = nrf
#
# See the west documentation for more information:
#
# https://developer.nordicsemi.com/nRF_Connect_SDK/doc/latest/zephyr/guides/west/index.html

manifest:
  version: "0.13"

  # "remotes" is a list of locations where git repositories are cloned
  # and fetched from.
  remotes:
    # nRF Connect SDK GitHub organization.
    # NCS repositories are hosted here.
    - name: ncs
      url-base: https://github.com/nrfconnect
    # Third-party repository sources:
    - name: zephyrproject
      url-base: https://github.com/zephyrproject-rtos
    - name: throwtheswitch
      url-base: https://github.com/ThrowTheSwitch
    - name: armmbed
      url-base: https://github.com/ARMmbed
    - name: nordicsemi
      url-base: https://github.com/NordicSemiconductor
    - name: dragoon
      url-base: https://projecttools.nordicsemi.no/bitbucket/scm/drgn
    - name: memfault
      url-base: https://github.com/memfault
    - name: ant-nrfconnect
      url-base: https://github.com/ant-nrfconnect
    - name: babblesim
      url-base: https://github.com/BabbleSim
    - name: bosch
      url-base: https://github.com/boschsensortec
    - name: mine
      url-base: https://github.com/nordicjm

  # If not otherwise specified, the projects below should be obtained
  # from the ncs remote.
  defaults:
    remote: ncs

  group-filter: [-homekit, -nrf-802154, -dragoon, -find-my, -ant, -babblesim, -sidewalk, -bsec]

  # "projects" is a list of git repositories which make up the NCS
  # source code.
  #
  # For 'userdata' fields in the projects area, please refer to:
  # https://developer.nordicsemi.com/nRF_Connect_SDK/doc/latest/nrf/dm_code_base.html
  projects:

    # The Zephyr RTOS fork in the NCS, along with the subset of its
    # modules which NCS imports directly.
    #
    # https://developer.nordicsemi.com/nRF_Connect_SDK/doc/latest/zephyr/introduction/index.html
    # https://developer.nordicsemi.com/nRF_Connect_SDK/doc/latest/zephyr/guides/modules.html
    - name: zephyr
      repo-path: sdk-zephyr
      revision: 02956222c991e2c036810a5e39fd60e72aa75866
      import:
        # In addition to the zephyr repository itself, NCS also
        # imports the contents of zephyr/west.yml at the above
        # revision. Only the projects explicitly named in the
        # following allowlist are imported.
        #
        # Note that the zephyr west extensions (like 'build', 'flash',
        # 'debug', etc.) are automatically provided by this import, so
        # there's no need to add a redundant west-commands: key for
        # the zephyr project.
        #
        # Please keep this list sorted alphabetically.
        name-allowlist:
          - cmsis
          - hal_nordic
          - libmetal
          - littlefs
          - open-amp
          - segger
          - tinycrypt
          - zcbor

    # NCS repositories.
    #
    # Some of these are also Zephyr modules which have NCS-specific
    # changes.
    - name: mcuboot
      repo-path: sdk-mcuboot
      revision: eafdae91cb0d357a0ee81014a8101abdc1917dbb
      path: bootloader/mcuboot
    - name: qcbor
      url: https://github.com/laurencelundblade/QCBOR.git
      revision: b0e7033268e88c9f27146fa9a1415ef4c19ebaff
      path: modules/tee/tf-m/qcbor
    - name: mbedtls
      path: modules/crypto/mbedtls
      repo-path: sdk-mbedtls
      revision: v3.3.0-ncs1
    - name: nrfxlib
      repo-path: sdk-nrfxlib
      path: nrfxlib
      revision: 66ee4d770aeeab6c520f4f50db0eb37e1dd97526
    - name: trusted-firmware-m
      repo-path: sdk-trusted-firmware-m
      path: modules/tee/tf-m/trusted-firmware-m
      revision: 6ad9c58f9bd55f386970533d0c9942dabe122945
    - name: matter
      repo-path: sdk-connectedhomeip
      path: modules/lib/matter
      revision: 7ab71116273ce80273d8c0e24c8c15fe11506a50
      submodules:
        - name: nlio
          path: third_party/nlio/repo
        - name: nlassert
          path: third_party/nlassert/repo
        - name: nlunit-test
          path: third_party/nlunit-test/repo
        - name: pigweed
          path: third_party/pigweed/repo
      userdata:
        ncs:
          upstream-url: https://github.com/project-chip/connectedhomeip
          upstream-sha: 8f66f4215bc0708efc8cc73bda80620e67d8955f
          compare-by-default: false
    - name: nrf-802154
      repo-path: sdk-nrf-802154
      path: nrf-802154
      revision: 73571fc9ec07725ae4979911bf4e306d4b9c0a19
      groups:
        - nrf-802154
    - name: cjson
      repo-path: sdk-cjson
      path: modules/lib/cjson
      revision: c6af068b7f05207b28d68880740e4b9ec1e4b50a
      userdata:
        ncs:
          upstream-url: https://github.com/DaveGamble/cJSON
          upstream-sha: d2735278ed1c2e4556f53a7a782063b31331dbf7
          compare-by-default: false
    - name: nrf-802154
      repo-path: sdk-nrf-802154
      path: nrf-802154
      revision: ef53e051cd04d62b330596f8982f4763f18e4148
      groups:
        - nrf-802154
    - name: openthread
      repo-path: sdk-openthread
      path: modules/lib/openthread
      revision: 79a3a26db601571829d803b61d6b390a87ea9810
      userdata:
        ncs:
          upstream-url: https://github.com/openthread/openthread
          upstream-sha: 650e30f81ccfd798409d459a86fb1ed575b5144a
          compare-by-default: false

  # West-related configuration for the nrf repository.
  self:
    # This repository should be cloned to ncs/nrf.
    path: nrf
    # This line configures west extensions.
    west-commands: scripts/west-commands.yml
```
