## tests/benchmarks/bootup_time/Kconfig.sysbuild
```kconfig
#
# Copyright (c) 2025 Nordic Semiconductor ASA
#
# SPDX-License-Identifier: LicenseRef-Nordic-5-Clause
#

config SUPPORT_NETCORE_TESTAPP
	bool "Support testapp as Netcore image"

choice NETCORE
	default NETCORE_TESTAPP if SUPPORT_NETCORE_TESTAPP

config NETCORE_TESTAPP
	bool "testapp image"

endchoice

if !NETCORE_NONE

config NETCORE_IMAGE_NAME
	default "testapp_cpunet" if NETCORE_TESTAPP

config NETCORE_IMAGE_PATH
	default "${ZEPHYR_NRF_MODULE_DIR}/tests/benchmarks/bootup_time/testapp" if NETCORE_TESTAPP

endif # !NETCORE_NONE

config SUPPORT_PPRCORE_TESTAPP
	bool "Support testapp as PPR core image"

choice PPRCORE
	default PPRCORE_TESTAPP if SUPPORT_PPRCORE_TESTAPP

config PPRCORE_TESTAPP
	bool "testapp image"

endchoice

if !PPRCORE_NONE

config PPRCORE_IMAGE_NAME
	default "testapp_cpuppr" if PPRCORE_TESTAPP

config PPRCORE_IMAGE_PATH
	default "${ZEPHYR_NRF_MODULE_DIR}/tests/benchmarks/bootup_time/testapp" if PPRCORE_TESTAPP

endif # !PPRCORE_NONE

config SUPPORT_FLPRCORE_TESTAPP
	bool "Support testapp as FLPR core image"

choice FLPRCORE
	default FLPRCORE_TESTAPP if SUPPORT_FLPRCORE_TESTAPP

config FLPRCORE_TESTAPP
	bool "testapp image"

endchoice

if !FLPRCORE_NONE

config FLPRCORE_IMAGE_NAME
	default "testapp_cpuflpr" if FLPRCORE_TESTAPP

config FLPRCORE_IMAGE_PATH
	default "${ZEPHYR_NRF_MODULE_DIR}/tests/benchmarks/bootup_time/testapp" if FLPRCORE_TESTAPP

endif # !FLPRCORE_NONE

source "share/sysbuild/Kconfig"
```

## tests/benchmarks/multicore/idle_spim_loopback/launcher/Kconfig.sysbuild
```kconfig
#
# Copyright (c) 2023 Nordic Semiconductor ASA
#
# SPDX-License-Identifier: LicenseRef-Nordic-5-Clause
#

if SUPPORT_PPRCORE

choice PPRCORE
	default PPRCORE_IDLE_SPIM_LOOPBACK

config PPRCORE_IDLE_SPIM_LOOPBACK
	bool "idle_spim_loopback image"

endchoice

config PPRCORE_IMAGE_NAME
	default "idle_spim_loopback" if PPRCORE_IDLE_SPIM_LOOPBACK

config PPRCORE_IMAGE_PATH
	default "$(APP_DIR)/../" if PPRCORE_IDLE_SPIM_LOOPBACK

endif # SUPPORT_PPRCORE

if SUPPORT_NETCORE

choice NETCORE
	default NETCORE_REMOTE_SLEEP_FOREVER

config NETCORE_REMOTE_SLEEP_FOREVER
	bool "remote_sleep_forever image"

endchoice

config NETCORE_IMAGE_NAME
	default "remote_sleep_forever" if NETCORE_REMOTE_SLEEP_FOREVER

config NETCORE_IMAGE_PATH
	default "$(ZEPHYR_NRF_MODULE_DIR)/tests/benchmarks/power_consumption/common/remote_sleep_forever" if NETCORE_REMOTE_SLEEP_FOREVER

endif # SUPPORT_NETCORE

source "share/sysbuild/Kconfig"
```
