/* Copyright (c) 2022 Nordic Semiconductor ASA
 *
 * SPDX-License-Identifier: LicenseRef-Nordic-5-Clause
 */

#include "nrf9160dk_nrf9160_ns-pinctrl.dtsi"

&spi3 {
	/* Disabled in non-secure image. */
	status = "disabled";
};
