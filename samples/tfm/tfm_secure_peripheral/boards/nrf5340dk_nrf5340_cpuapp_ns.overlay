/* Copyright (c) 2022 Nordic Semiconductor ASA
 *
 * SPDX-License-Identifier: LicenseRef-Nordic-5-Clause
 */

#include "nrf5340dk_nrf5340_cpuapp_ns-pinctrl.dtsi"

&spi3 {
	/* Disabled in non-secure image. */
	status = "disabled";
};
